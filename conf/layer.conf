## conf/layer.conf
```bitbake
# We have a conf and classes directory, add to BBPATH
BBPATH .= ":${LAYERDIR}"

# We have recipes-* directories, add to BBFILES
BBFILES += "${LAYERDIR}/recipes-*/*/*.bb \
        ${LAYERDIR}/recipes-*/*/*.bbappend"

BBFILE_COLLECTIONS += "mediatek-layer"
BBFILE_PATTERN_mediatek-layer = "^${LAYERDIR}/"
BBFILE_PRIORITY_mediatek-layer = "6"

LAYERDEPENDS_mediatek-layer = "core swupdate"
```

## conf/machine/include/mt7623-default.inc
```bitbake
# Mediatek MT7623 default BSP

# TODO: try adding hard float (hf) - this currently makes u-boot choke and
# the perl cross-compile config probably needs adjusting as well. Not a
# priority since performance gains are likely minimal - routers don't use FP
#DEFAULTTUNE ?= "cortexa7thf-neon-vfpv4"

# Cortex A7 Thumb, Neon VFPv4
DEFAULTTUNE ?= "cortexa7t-neon-vfpv4"
require conf/machine/include/tune-cortexa7.inc

PREFERRED_PROVIDER_virtual/kernel = "linux-mtk"
PREFERRED_VERSION_linux-mtk = "4.14%"
LINUX_VERSION_EXTENSION ?= "-mt7623"

KERNEL_IMAGETYPE ?= "zImage"

UBOOT_LOADADDRESS = "0x80008000"
UBOOT_ENTRYPOINT = "0x80008000"

PREFERRED_PROVIDER_virtual/bootloader = "u-boot"
PREFERRED_VERSION_u-boot = "2014.04"
PREFERRED_VERSION_u-boot-fw-utils = "2014.04"

# kernel and devicetree should be part of rootfs
IMAGE_INSTALL_append = " kernel kernel-modules"

# extra options for embedded to minimize Flash wear
EXTRA_IMAGECMD_ext4 = "-b 1024 -j -O sparse_super,filetype,^resize_inode,dir_index,^ext_attr,^64bit,^dir_nlink,extent,extra_isize,flex_bg,^huge_file,large_file,^meta_bg,^quota -I 128 -i 4096"

SOC_FAMILY = "mt7623"
require conf/machine/include/soc-family.inc

# turn errors into warnings in cases where original recipe is missing
BB_DANGLINGAPPENDS_WARNONLY = "1"

# all MT7623 platforms so far use either eMMC or SD cards, so the persistent data
# partition shall be the third partition of either one of these.
# This partition will be created during first boot if it doesn't already exist.
# Check the 'initscripts' package extension that's part of this layer
PERSISTENT_DATA_PART = "3"
```

## conf/machine/mt7623-bpi-r2.conf
```bitbake
#@TYPE: Machine
#@NAME: Mediatek MT7623 BPI-R2
#@DESCRIPTION: Machine configuration for Mediatek (MTK) MT7623N Banana-Pi R2 (eMMC)
#@MAINTAINER:

include conf/machine/include/mt7623-default.inc

KERNEL_DEVICETREE = "mt7623n-bananapi-bpi-r2.dtb"
KERNEL_IMAGETYPE = "uImage"
KERNEL_EXTRA_ARGS += "LOADADDR=${UBOOT_ENTRYPOINT}"

SERIAL_CONSOLE = "115200 ttyS2"

#UBOOT_MACHINE_mt7623-bpi-r2 = "mt7623-bpi-r2_config"
UBOOT_CONFIG = "emmc sd"
UBOOT_CONFIG[emmc] = "mt7623-bpi-r2-emmc_config,mtk.emmc"
UBOOT_CONFIG[sd] = "mt7623-bpi-r2-sd_config,mtk.sd"

LINUX_VERSION_EXTENSION = "-mt7623-bpi-r2"

# currently ('master' / April 2018), this yields swupdate version
# 2018.03. TODO: pin to specific version
PREFERRED_VERSION_swupdate = "2018.03"

# we need ext4 for installation on SD card or EMMC, needs modification if
# target platform uses NAND
IMAGE_CLASSES += "image_types_mtk"
IMAGE_FSTYPES += " ext4 tar.gz mtk.emmc mtk.sd"

# IMAGE_ROOTFS_SIZE [decimal, in KiB] should match EMMC_ROOTFS_SIZE below
IMAGE_ROOTFS_SIZE = "391168"

# the following variables are used by the image_types_mkt class to generate
# the eMMC image package which includes:
#  - preloader (pre-compiled binary from MTK)
#  - partition table (2x rootfs partions and 1x persistent data partition)
#  - u-boot and u-boot environment
#  - root file system which includes the kernel
#  - scatter file to be used with MTK's 'flash tool'

# [Total eMMC size: 3.5G, in KiB]
EMMC_SIZE = "3417968"

# size and offset of various paritions [in hex]
#   u-boot and u-boot environment
#   (environment position is hard-coded in u-boot source)
EMMC_UBOOT_SIZE = "0x80000"
EMMC_UBOOT_OFFSET = "0x50000"
EMMC_UBOOT_ENV_SIZE = "0x4000"
EMMC_UBOOT_ENV_OFFSET = "0x4c000"

# 2x rootfs partitions for redundant images
MTK_ROOTFS_SIZE = "0x17e00000"
MTK_ROOTFS1_OFFSET = "0x200000"
MTK_ROOTFS2_OFFSET = "0x18000000"

# persistent data partition
EMMC_DATA_SIZE = "0xA0000000"
EMMC_DATA_OFFSET = "0x30000000"


# the following variables are used by the image_types_mkt class to generate
# the SD card image. They can be the same as the corresponding eMMC values
# above, but don't have to be

# [Total SD card size: 3.5G, in KiB]
SD_SIZE = "3417968"

# size and offset of various paritions [in hex]
#   u-boot and u-boot environment
#   (environment position is hard-coded in u-boot source)
SD_UBOOT_OFFSET = "0x50000"
SD_UBOOT_ENV_OFFSET = "0x4c000"

# 2x rootfs partitions, uses MTK_ROOTFS* values above

# persistent data partition
SD_DATA_SIZE = "0xA0000000"
SD_DATA_OFFSET = "0x30000000"
```

## conf/machine/mt7623-evb.conf
```bitbake
#@TYPE: Machine
#@NAME: Mediatek MT7623 EVB
#@DESCRIPTION: Machine configuration for Mediatek (MTK) MT7623A reference board (eMMC)
#@MAINTAINER:

include conf/machine/include/mt7623-default.inc

KERNEL_DEVICETREE = "mt7623a-rfb-emmc.dtb"
KERNEL_IMAGETYPE = "fitImage"
KERNEL_CLASSES += "kernel-fitimage"

SERIAL_CONSOLE = "115200 ttyS0"

UBOOT_CONFIG = "emmc"
UBOOT_CONFIG[emmc] = "mt7623-evb-emmc_config,mtk.emmc"

LINUX_VERSION_EXTENSION = "-mt7623-evb"

# currently ('master' / April 2018), this yields swupdate version
# 2018.03. TODO: pin to specific version
PREFERRED_VERSION_swupdate = "2018.03"

# for now we disable RTC support
#MACHINE_FEATURES_BACKFILL_CONSIDERED = "rtc"

# we need ext4 for installation on SD card or EMMC, needs modification if
# target platform uses NAND
IMAGE_CLASSES += "image_types_mtk"
IMAGE_FSTYPES += " ext4 tar.gz mtk.emmc"


# IMAGE_ROOTFS_SIZE [decimal, in KiB] should match EMMC_ROOTFS_SIZE below
IMAGE_ROOTFS_SIZE = "391168"

# the following variables are used by the image_types_mkt class to generate
# the eMMC image package which includes:
#  - preloader (pre-compiled binary from MTK)
#  - partition table (2x rootfs partions and 1x persistent data partition)
#  - u-boot and u-boot environment
#  - root file system which includes the kernel
#  - scatter file to be used with MTK's 'flash tool'

# [Total eMMC size: 3.5G, in KiB]
EMMC_SIZE = "3417968"

# size and offset of various paritions [in hex]
#   u-boot and u-boot environment
#   (environment position is hard-coded in u-boot source)
EMMC_UBOOT_SIZE = "0x80000"
EMMC_UBOOT_OFFSET = "0x40000"
EMMC_UBOOT_ENV_SIZE = "0x4000"
EMMC_UBOOT_ENV_OFFSET = "0x3c000"

# 2x rootfs partitions for redundant images
MTK_ROOTFS_SIZE = "0x17e00000"
MTK_ROOTFS1_OFFSET = "0x200000"
MTK_ROOTFS2_OFFSET = "0x18000000"

# persistent data partition
EMMC_DATA_SIZE =   "0xA0000000"
EMMC_DATA_OFFSET = "0x30000000"
```
